#include "lcd5110.h"

const uint8_t font6x8[][6] =
{
  { 0x00, 0x00, 0x00, 0x00, 0x00, 0x00 },   // sp
  { 0x00, 0x00, 0x00, 0x2f, 0x00, 0x00 },   // !
  { 0x00, 0x00, 0x07, 0x00, 0x07, 0x00 },   // "
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  { 0x00, 0x00, 0x00, 0x07, 0x05, 0x07 }    //   
};


void LCD5110_ShiftOut(uint8_t TxData)
{

  SPI_Send_Byte(TxData);
	
//	uint8_t i;
//	GPIO_ResetBits(LCD5110_PORT,CLK_PIN);
//  GPIO_SetBits(LCD5110_PORT,DIN_PIN);
//  for(i = 8; i > 0; i--)
//  {
//    if ((TxData & 0x80) == 0x80)
//      GPIO_SetBits(LCD5110_PORT, DIN_PIN);
//    else
//      GPIO_ResetBits(LCD5110_PORT, DIN_PIN);
//    
//    GPIO_SetBits(LCD5110_PORT, CLK_PIN);
//    
//    GPIO_ResetBits(LCD5110_PORT, CLK_PIN);
//    
//    TxData <<= 1;
//	}
}
void LCD5110_Write(uint8_t DC, uint8_t Data_Transfer)
{
  if (DC)
    GPIO_SetBits(LCD5110_PORT, DC_PIN);
  else
    GPIO_ResetBits(LCD5110_PORT, DC_PIN);
   
	EnableLCD;
  LCD5110_ShiftOut(Data_Transfer); 
	DisableLCD;
}

void LCD5110_GotoXY(uint8_t x,uint8_t y)
{
  LCD5110_Write(LCD5110_CMD,0x80 | x);
  LCD5110_Write(LCD5110_CMD,0x40 | y);
}

void LCD5110_Clr(void)
{
  uint16_t i;
  for (i = 0; i < (LCD_X * LCD_Y / 8); i++)
		LCD5110_Write(LCD5110_DATA, 0x00);

  LCD5110_GotoXY(0,0);
}

void LCD5110_write_char(uint8_t c)
{
  uint8_t line;
  
  c -= 32;
  
  for (line = 0; line < 6; line++)
    LCD5110_Write(LCD5110_DATA, font6x8[c][line]);
}

void LCD5110_write_sring(uint8_t *str)
{
  while (*str != 0)
  {
    LCD5110_write_char(*str);
    str++;
  }
}
void LCD5110_Bitmap(unsigned char arr[])
{
	unsigned int i;
  for (i = 0 ; i < (LCD_X * LCD_Y / 8) ; i++)
    LCD5110_Write(LCD5110_DATA, arr[i]);
}

void LCD5110_Init(void)
{
  SPI_LCD5110_Configuration(); 
	
	GPIO_SetBits(LCD5110_PORT, CE_PIN);
	GPIO_ResetBits(LCD5110_PORT,DC_PIN);
  GPIO_ResetBits(LCD5110_PORT, RST_PIN);		//tao tin hieu reset LCD
  SystemTick_Delay_Us(100); 
  GPIO_SetBits(LCD5110_PORT, RST_PIN);
	
  LCD5110_Write(LCD5110_CMD, 0x21);
	LCD5110_Write(LCD5110_CMD, 0x80 + 80/*| 0x31*/);      //contrast
  LCD5110_Write(LCD5110_CMD, 0x04); 			      //coefficient	
  LCD5110_Write(LCD5110_CMD, 0x10 + 20/*| 0x01*/);      //bias
  LCD5110_Write(LCD5110_CMD, 0x20);
  LCD5110_Write(LCD5110_CMD, 0x0C);
}
